## drivers/misc/mediatek/sensors-1.0/gyroscope/bmi160gy-i2c/Kconfig
```kconfig
config MTK_BMI160GY_I2C
	bool "MTK_BMI160GY_I2C for MediaTek package"
	default n
	help
	  It support different gyroscope sensor.
	  If this option is set,
  	  it will support
	  BMI120 gyroscope.
```

## drivers/misc/mediatek/sensors-1.0/step_counter/Kconfig
```kconfig
config CUSTOM_KERNEL_STEP_COUNTER
	bool "CUSTOM_KERNEL_STEP_COUNTER"
	help
	  A step counter is a device, usually portable and electronic or electromechanical,
	  that counts each step a person takes by detecting the motion of the person's hands or hips.

config CUSTOM_KERNEL_SIGNIFICANT_MOTION_SENSOR
	bool "BMI160 significant motion sensor"
	depends on CUSTOM_KERNEL_STEP_COUNTER
	help
	  Enable the Android significant-motion wake-up sensor backed by the
	  physical BMI160 accelerometer interrupt.

source "drivers/misc/mediatek/sensors-1.0/step_counter/bmi160_stc/Kconfig"
```

## drivers/misc/mediatek/sensors-1.0/step_counter/bmi160_stc/Kconfig
```kconfig
config MTK_BMI160_STC
	bool "BMI160 stc for MediaTek package"
	depends on MTK_BMI160_I2C && CUSTOM_KERNEL_STEP_COUNTER
	default n
	help
	It support different step counter sensor.
	If this option is set,
	 it will support
	 BMI160 step counter.
```
